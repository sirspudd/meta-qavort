## conf/distro/qavort.conf
```bitbake
require conf/distro/include/rk-base.inc

# Remove conflicting backends.
DISTRO_FEATURES_remove = "x11"

DISTRO = "qavort"
DISTRO_NAME = "qavort"
DISTRO_VERSION = "0.0.1"
MAINTAINER = "Donald Carr d@chaos-reins.com"

SELECTED_OPTIMIZATION = "-Os"

# original DISTRO_FEATURES
# DISTRO_FEATURES="acl alsa argp bluetooth ext2 irda largefile pcmcia usbgadget usbhost wifi xattr nfs zeroconf pci 3g nfc ipv4 ipv6 libc-backtrace libc-big-macros libc-bsd libc-cxx-tests libc-catgets libc-charsets libc-crypt libc-crypt-ufc libc-db-aliases libc-envz libc-fcvt libc-fmtmsg libc-fstab libc-ftraverse libc-getlogin libc-idn libc-inet-anl libc-libm libc-locales libc-locale-code libc-memusage libc-nis libc-nsswitch libc-rcmd libc-rtld-debug libc-spawn libc-streams libc-sunrpc libc-utmp libc-utmpx libc-wordexp libc-posix-clang-wchar libc-posix-regexp libc-posix-regexp-glibc libc-posix-wchar-io opengl wayland vulkan wayland systemd ld-is-gold vulkan pulseaudio sysvinit bluez5 gobject-introspection-data ldconfig"

# rockchips https://github.com/rockchip-linux/libmali/raw/rockchip/lib/arm-linux-gnueabihf/libmali-midgard-t76x-r14p0-r0p0-wayland.so does not exist
# wayland 
DISTRO_FEATURES = "${DISTRO_FEATURES_LIBC} alsa ld-is-gold vulkan opengl vulkan wifi opengl zeroconf ipv4 systemd pulseaudio ldconfig"

PACKAGECONFIG_append_pn-qtbase = " qml-debug libs eglfs linuxfb journald gbm sql-sqlite libinput glib"
PACKAGECONFIG_remove_pn-qtbase = " widgets accessibility examples tests tools"

# ARM_INSTRUCTION_SET = "thumb"
PREFERRED_VERSION_linux-rockchip = "4.4.103"

# Fuck QA
ERROR_QA = ""
```

## conf/layer.conf
```bitbake
# It really depends on order of the layers appearing in BBLAYERS
# variable in toplevel bblayers.conf file, where bitbake will search
# for .inc files and others where bitbake uses BBPATH since it will
# search the directories from first to last as specified in BBPATH
# Therefore if you want a given layer to be considered high priority
# for the .inc and .conf etc. then consider it adding at the beginning
# of BBPATH. For bblayers bitbake will use BBFILES_PRIORITY to resolve
# the recipe contention so the order of directories in BBFILES does
# not matter.

# We have a conf and classes directory, append to BBPATH
BBPATH .= ":${LAYERDIR}"

# We have a recipes directory, add to BBFILES
BBFILES += "${LAYERDIR}/recipes-*/*/*.bb ${LAYERDIR}/recipes-*/*/*.bbappend"

BBFILE_COLLECTIONS += "qavort-layer"
BBFILE_PATTERN_qavort-layer := "^${LAYERDIR}/"

# Define the priority for recipes (.bb files) from this layer,
# choosing carefully how this layer interacts with all of the
# other layers.

BBFILE_PRIORITY_qavort-layer = "20"

# This should only be incremented on significant changes that will
# cause compatibility issues with other layers
LAYERVERSION_qavort-layer = "1"

LAYERDEPENDS_qavort-layer = "core"

LAYERSERIES_COMPAT_qavort-layer = "sumo"

LICENSE_PATH += "${LAYERDIR}/licenses"
```
